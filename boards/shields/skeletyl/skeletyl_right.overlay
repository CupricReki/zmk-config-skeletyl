#include "skeletyl.dtsi"

&default_transform { // The matrix transform for this board is 5
    col-offset = <5>;
};

// when using amoeba, put GPIO_PULL_DOWN in cols instead

&kscan0 {
    row-gpios
        = <&gpio1 15 (GPIO_ACTIVE_HIGH | GPIO_PULL_DOWN)> // row0
        , <&gpio0 24 (GPIO_ACTIVE_HIGH | GPIO_PULL_DOWN)> // row1
        , <&gpio0 22 (GPIO_ACTIVE_HIGH | GPIO_PULL_DOWN)> // row2
        , <&gpio1 6 (GPIO_ACTIVE_HIGH | GPIO_PULL_DOWN)> // row3
        ;
    col-gpios
        = <&gpio0 4 (GPIO_ACTIVE_HIGH)> // col0
        , <&gpio0 11 (GPIO_ACTIVE_HIGH)> // col1
        , <&gpio1 0 (GPIO_ACTIVE_HIGH)> // col2
        , <&gpio0 9 (GPIO_ACTIVE_HIGH)> // col3
        , <&gpio0 29 (GPIO_ACTIVE_HIGH)> // col4
        ;
};
